## conf/bblayers.conf.sample
```bitbake
# POKY_BBLAYERS_CONF_VERSION is increased each time build/conf/bblayers.conf
# changes incompatibly
POKY_BBLAYERS_CONF_VERSION = "2"

BBPATH = "${TOPDIR}"
BBFILES ?= ""

BBLAYERS ?= " \
    /media/jennifer/LinDrive/tdde21/poky-warrior/meta \
    /media/jennifer/LinDrive/tdde21/poky-warrior/meta-poky \
    /media/jennifer/LinDrive/tdde21/poky-warrior/meta-openembedded/meta-oe \
    /media/jennifer/LinDrive/tdde21/poky-warrior/meta-openembedded/meta-multimedia \
    /media/jennifer/LinDrive/tdde21/poky-warrior/meta-openembedded/meta-networking \
    /media/jennifer/LinDrive/tdde21/poky-warrior/meta-openembedded/meta-perl \
    /media/jennifer/LinDrive/tdde21/poky-warrior/meta-openembedded/meta-python \
    /media/jennifer/LinDrive/tdde21/poky-warrior/meta-qt5 \
    /media/jennifer/LinDrive/tdde21/poky-warrior/meta-raspberrypi \
    /media/jennifer/LinDrive/tdde21/rpi/meta-rpi \
    /media/jennifer/LinDrive/tdde21/poky-warrior/meta-tdde21 \
"
```

## conf/layer.conf
```bitbake
# We have a conf and classes directory, add to BBPATH
BBPATH .= ":${LAYERDIR}"

# We have recipes-* directories, add to BBFILES
BBFILES += "${LAYERDIR}/recipes-*/*/*.bb \
            ${LAYERDIR}/recipes-*/*/*.bbappend"

BBFILE_COLLECTIONS += "meta-tdde21"
BBFILE_PATTERN_meta-tdde21 = "^${LAYERDIR}/"
BBFILE_PRIORITY_meta-tdde21 = "10"

LAYERSERIES_COMPAT_meta-tdde21 = "warrior"
```
